## wearable/sw/boards/ezurio/snoozy/KConfig.snoozy
```kconfig
config BOARD_SNOOZY
    select SOC_NRF54L15_CPUAPP if BOARD_SNOOZY_NRF54L15_CPUAPP || BOARD_SNOOZY_NRF54L15_CPUAPP_NS
```

## wearable/sw/boards/ezurio/snoozy/board.yml
```yaml
board:
  name: snoozy
  vendor: ezurio
  socs:
  - name: nrf54l15 # not bl54l15 since that's the module, not the SoC.
    variants:
    - name: ns # we don't need other variants at this time.
      cpucluster: cpuapp
runners:
  run_once:
    '--recover':
      - runners:
          - nrfjprog
          - nrfutil
        run: first
        groups:
          - boards:
              - snoozy/nrf54l15/cpuapp
              - snoozy/nrf54l15/cpuapp/ns
    '--erase':
      - runners:
          - nrfjprog
          - jlink
          - nrfutil
        run: first
        groups:
          - boards:
              - snoozy/nrf54l15/cpuapp
              - snoozy/nrf54l15/cpuapp/ns
    '--reset':
      - runners:
          - nrfjprog
          - jlink
          - nrfutil
        run: last
        groups:
          - boards:
              - snoozy/nrf54l15/cpuapp
              - snoozy/nrf54l15/cpuapp/ns
```

## wearable/sw/boards/ezurio/snoozy/snoozy_nrf54l15_cpuapp_defconfig
```kconfig
# Copyright (c) 2024 Nordic Semiconductor ASA
# Copyright (c) 2025 Ezurio LLC
# SPDX-License-Identifier: Apache-2.0

# Enable UART driver
CONFIG_SERIAL=y

# Enable console
CONFIG_CONSOLE=y
CONFIG_UART_CONSOLE=y

# Enable GPIO
CONFIG_GPIO=y

# Enable SPI
CONFIG_SPI=y

# Enable I2C
CONFIG_I2C=y

# Enable MPU
CONFIG_ARM_MPU=y

# Enable hardware stack protection
CONFIG_HW_STACK_PROTECTION=y

# Enable bluetooth
CONFIG_BT=y
```
